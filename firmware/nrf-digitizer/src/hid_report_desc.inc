// HID report descriptor of the TouchBridge Digitizer (generated layout, keep in sync with PROTOCOL.md).
// Windows-precision-touchscreen style touch screen, "parallel" mode: all 10 contacts in one report.
//
//   Input report 1 (64 bytes incl. report ID):
//     10 x { bit0 Tip Switch, bit1 Confidence, 6 bit padding, u8 Contact Identifier,
//            u16 X 0..32767, u16 Y 0..32767 }            = 60 bytes
//     u16 Scan Time (100 us units), u8 Contact Count     =  3 bytes
//   Feature report 2: u8 Contact Count Maximum (10)
//
// Physical size: 301.6 x 188.5 mm (14" 16:10 panel), unit cm with exponent -2.
// This file holds plain bytes only: the Swift tests (Tests/TouchBridgeCoreTests/NRFDigitizerTests.swift)
// read it and compare it with NRFDigitizer.reportDescriptor in TouchBridgeCore.
    0x05, 0x0D,             // Usage Page (Digitizer)
    0x09, 0x04,             // Usage (Touch Screen)
    0xA1, 0x01,             // Collection (Application)
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    0xC0,                   // End Collection
